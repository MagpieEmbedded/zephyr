## boards/raspberrypi/rpi_pico2/Kconfig.defconfig
```kconfig
# Copyright (c) 2024 Andrew Featherstone
# SPDX-License-Identifier: Apache-2.0

if BOARD_RPI_PICO2

config USB_SELF_POWERED
	default n

config HEAP_MEM_POOL_ADD_SIZE_BOARD
	int
	default 16384 if NETWORKING

if WIFI_AIROC

choice AIROC_PART
	default CYW43439
endchoice

config WHD_DISABLE_SDIO_PULLUP_DURING_SPI_SLEEP
	default y

endif # WIFI_AIROC

endif # BOARD_RPI_PICO2
```

## drivers/gpio/KConfig.gpio_airoc
```kconfig
config GPIO_AIROC
	bool "AIROC GPIO ENABLED"
	default y
	depends on DT_HAS_GPIO_AIROC_ENABLED
	depends on SPI
	help
	  Use Airoc wifi driver for GPIO
```

## drivers/gpio/Kconfig.gpio_airoc
```kconfig
config GPIO_INFINEON_AIROC
	bool "AIROC GPIO ENABLED"
	default y
	depends on DT_HAS_INFINEON_AIROC_GPIO_ENABLED
	depends on CYW43439
	depends on WIFI_AIROC
	depends on WIFI
	help
	  Use Infineon Airoc wifi driver for GPIO
```

## dts/bindings/gpio/infineon,airoc-gpio.yaml
```yaml
# Copyright 2020, Friedt Professional Engineering Services, Inc
# SPDX-License-Identifier: Apache-2.0

description: GPIO Emulator

compatible: "infineon,airoc-gpio"

include: [gpio-controller.yaml, base.yaml]

properties:
  "#gpio-cells":
    const: 2

gpio-cells:
  - pin
  - flags
```
